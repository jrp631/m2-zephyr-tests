## CMakeLists.txt
```
# SPDX-License-Identifier: Apache-2.0

cmake_minimum_required(VERSION 3.20.0)

find_package(Zephyr REQUIRED HINTS $ENV{ZEPHYR_BASE})
project(tick_test)

target_sources(app PRIVATE src/main.c)

target_include_directories(app PRIVATE ${ZEPHYR_BASE}/lib/posix/options)
target_include_directories(app PRIVATE ${ZEPHYR_BASE}/kernel/include)    
```

## prj.conf
```kconfig
#CONFIG_POSIX_API=y
#
##CONFIG_POSIX_PRIORITY_SCHEDULING=y # for sched_get_priority_min(), sched_get_priority_max()
#CONFIG_PTHREAD_IPC=y 
#
## Habilitar soporte para nanosleep
#CONFIG_POSIX_TIMERS=y
## API POSIX para threads
#CONFIG_POSIX_THREADS=y
#CONFIG_SCHED_DUMB=y 
#CONFIG_WAITQ_DUMB=y
#CONFIG_TIMESLICE_SIZE=100 
#CONFIG_POSIX_THREAD_ATTR_STACKSIZE=y
#CONFIG_POSIX_THREAD_CPUTIME=y
#
#CONFIG_TIMING_FUNCTIONS=y
#
##CONFIG_THREAD_ANALYZER_AUTO=y
#CONFIG_THREAD_ANALYZER=y
#CONFIG_THREAD_RUNTIME_STATS=y
##CONFIG_THREAD_NAME=y
#
#CONFIG_SCHED_THREAD_USAGE=y
#CONFIG_SCHED_THREAD_USAGE_ANALYSIS=y
#
#CONFIG_PRINTK=y
#
##OPCIONES DE OPTIMIZACION
#CONFIG_DEBUG=n
#CONFIG_DEBUG_OPTIMIZATIONS=n
#CONFIG_NO_OPTIMIZATIONS=n
#CONFIG_SIZE_OPTIMIZATIONS=y
#CONFIG_COMPILER_OPT="-02"

CONFIG_THREAD_NAME=y #habilita darle nombre a los threads
CONFIG_THREAD_STACK_INFO=y #habilita la informacion del stak en una struct k_thread
#CONFIG_HEAP_MEM_POOL_SIZE=4096
CONFIG_NUM_PREEMPT_PRIORITIES=5

#indicamos algoritmo de planificacion 
CONFIG_SCHED_DUMB=y 
#enablet timing functions
CONFIG_TIMING_FUNCTIONS=y
```

## src/main.c
```c
#include "../headers/headers.h"

#define LOOPS 6

int64_t uptime_get[LOOPS];
uint32_t cycle_get_32[LOOPS];
uint64_t cycle_get_64[LOOPS];
uint32_t clock_cycle_get_32[LOOPS];
uint64_t clock_cycle_get_64[LOOPS];

int main(int argc, char **argv)
{
  m2osinit();
  console_init(115200);

  printf("\nMain starts\n");
/*
  // k_uptime_get
  printf("k_uptime_get...\n");
  for (int i = 0; i < LOOPS; i++)
  {
    if (LOOPS%2 == 0)
    {
      k_sleep(K_MSEC(1000));
    }
    uptime_get[i] = k_uptime_get();
  }
  // k_cycle_get_32
  printf("k_cycle_get_32...\n");
  for (int i = 0; i < LOOPS; i++)
  {
    if (LOOPS%2 == 0)
    {
      k_sleep(K_MSEC(1000));
    }
    cycle_get_32[i] = k_cycle_get_32();
  }
  // k_cycle_get_64
  printf("k_cycle_get_64...\n");
  for (int i = 0; i < LOOPS; i++)
  {
    if (LOOPS%2 == 0)
    {
      k_sleep(K_MSEC(1000));
    }
    cycle_get_64[i] = k_cycle_get_64();
  }
  // sys_clock_cycle_get_32
  printf("sys_clock_cycle_get_32...\n");
  for (int i = 0; i < LOOPS; i++)
  {
    if (LOOPS%2 == 0)
    {
      k_sleep(K_MSEC(1000));
    }
    clock_cycle_get_32[i] = sys_clock_cycle_get_32();
  }

  // sys_clock_cycle_get_64
  printf("sys_clock_cycle_get_64...\n");
  for (int i = 0; i < LOOPS; i++)
  {
    if (LOOPS%2 == 0)
    {
      k_sleep(K_MSEC(1000));
    }
    clock_cycle_get_64[i] = sys_clock_cycle_get_64();
  }

  // print the results int a table format
  printf("%-20s %-20s %-20s %-20s %-20s\n", "k_uptime_get", "k_cycle_get_32", "k_cycle_get_64", "sys_clock_cycle_get_32", "sys_clock_cycle_get_64");
  for (int i = 0; i < LOOPS; i++)
  {
    printf("Loop: %d\n", i);
    printf("%-20lld %-20u %-20lld %-20u %-20lld\n", uptime_get[i], cycle_get_32[i], cycle_get_64[i], clock_cycle_get_32[i], clock_cycle_get_64[i]);
  }
*/
  for (int i = 0; i < LOOPS; i++)
  {
    if(i == LOOPS/2){
      k_sleep(K_MSEC(30000)); // 30 seconds to check if the tick overflow
    }
    clock_cycle_get_64[i] = sys_clock_cycle_get_64();
  }
  for (int i = 0; i < LOOPS; i++)
  {
    printf("Loop: %d\n", i);
    printf("%-20lld\n", clock_cycle_get_64[i]);
  }
  printf("\nMain ends");
  return 0;
}
```
