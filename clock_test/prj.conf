## CMakeLists.txt
```
# SPDX-License-Identifier: Apache-2.0

cmake_minimum_required(VERSION 3.20.0)

find_package(Zephyr REQUIRED HINTS $ENV{ZEPHYR_BASE})
project(clock_test)

target_sources(app PRIVATE src/main.c)

target_include_directories(app PRIVATE ${ZEPHYR_BASE}/lib/posix/options)
target_include_directories(app PRIVATE ${ZEPHYR_BASE}/kernel/include)    
```

## prj.conf
```kconfig
CONFIG_POSIX_API=y

CONFIG_POSIX_PRIORITY_SCHEDULING=y # for sched_get_priority_min(), sched_get_priority_max()
CONFIG_PTHREAD_IPC=y 
# Habilitar soporte para nanosleep
CONFIG_POSIX_TIMERS=y
# API POSIX para threads
CONFIG_POSIX_THREADS=y
CONFIG_SCHED_DUMB=y 
CONFIG_WAITQ_DUMB=y
CONFIG_TIMESLICE_SIZE=100 
CONFIG_POSIX_THREAD_ATTR_STACKSIZE=y
CONFIG_POSIX_THREAD_CPUTIME=y

#CONFIG_THREAD_ANALYZER_AUTO=y

# CONFIG_THREAD_ANALYZER=y
# CONFIG_THREAD_RUNTIME_STATS=y
# CONFIG_THREAD_NAME=y

# CONFIG_SCHED_THREAD_USAGE=y
# CONFIG_SCHED_THREAD_USAGE_ANALYSIS=y

CONFIG_PRINTK=y

#OPCIONES DE OPTIMIZACION
#CONFIG_DEBUG=y 

#CONFIG_DEBUG=n
#CONFIG_DEBUG_OPTIMIZATIONS=n
#CONFIG_NO_OPTIMIZATIONS=n
#CONFIG_SIZE_OPTIMIZATIONS=y
#CONFIG_COMPILER_OPT="-02"
CONFIG_SPEED_OPTIMIZATIONS=y
```

## src/main.c
```c
#include "../headers/headers.h"

//THREAD_POOL(1);

#define NUM_OF_LOOPS 10000
struct timespec ts;
int loop_counter = 0;

int main(int argc, char **argv)
{
  m2osinit();
  console_init(115200);
  print_console("\nMain starts\n");
  print_console("Clock Sys CLock Ticks per sec: ");
  print_console_int(CONFIG_SYS_CLOCK_TICKS_PER_SEC);
  print_console_newline();
  print_console("Clock Test\n");
  print_console("NUM_OF_LOOPS: ");
  print_console_int(NUM_OF_LOOPS);
  print_console("\n");

  measurements_hires__init();

  while (loop_counter < 30)
  {
    measurements_hires__start_measurement();
    for (int i = 0; i < NUM_OF_LOOPS; i++)
    {
      clock_gettime(CLOCK_MONOTONIC, &ts);
    }
    measurements_hires__end_measurement();
    loop_counter++;

    measurements_hires__finish();
  }

  print_console("\nMain ends");
  tests_reports__test_ok(); // This is the last line of the main function
  return 0;
}
```
