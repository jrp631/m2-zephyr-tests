## prj.conf
```kconfig
CONFIG_POSIX_API=y
#CONFIG_TICKLESS_KERNEL=y
CONFIG_POSIX_PRIORITY_SCHEDULING=y # for sched_get_priority_min(), sched_get_priority_max()
CONFIG_PTHREAD_IPC=y 
# Habilitar soporte para nanosleep
CONFIG_POSIX_TIMERS=y
# API POSIX para threads
CONFIG_POSIX_THREADS=y
CONFIG_SCHED_DUMB=y 
CONFIG_WAITQ_DUMB=y
#CONFIG_TIMESLICE_SIZE= # 100 comentado para que se cambie en función del test 
CONFIG_POSIX_THREAD_ATTR_STACKSIZE=y
CONFIG_POSIX_THREAD_CPUTIME=y

#Tickless time 
#CONFIG_TICKLESS_KERNEL=y

#CONFIG_THREAD_ANALYZER_AUTO=y

#CONFIG_THREAD_ANALYZER=y
#CONFIG_THREAD_RUNTIME_STATS=y
#CONFIG_THREAD_NAME=y
#
#CONFIG_SCHED_THREAD_USAGE=y
#CONFIG_SCHED_THREAD_USAGE_ANALYSIS=y

CONFIG_PRINTK=y

#OPCIONES DE OPTIMIZACION
# CONFIG_DEBUG=n
# CONFIG_DEBUG_OPTIMIZATIONS=n
# CONFIG_NO_OPTIMIZATIONS=n
# CONFIG_SIZE_OPTIMIZATIONS=y
# CONFIG_COMPILER_OPT="-02"
CONFIG_SPEED_OPTIMIZATIONS=y
```

## src/main.c
```c
#include "../headers/headers.h"

THREAD_POOL(2);

#define NUM_THREADS 2
#define STACK_SIZE 512

K_THREAD_STACK_ARRAY_DEFINE(thread_stack, NUM_THREADS, STACK_SIZE);

#define NUM_OF_LOOPS 20
#define PERIOD1_NS 20000000 // -> 20ms 

const struct timespec period1 = TS(0, 0);

int loop_counter_1 = 0;
struct timespec start_time_t1;

int loop_counter_2 = 0;
bool other_task_executed = false;

//*******//
// TASK1 //
//*******//
struct timespec next_time1;
k_timeout_t period1_k = K_MSEC(0);
k_timeout_t next_time1_k = K_MSEC(20);

void *
task1()
{
  while (1)
  {
#ifdef _ZEPHYR__VERBOSE_
    print_console("Task1\n");
#endif // _ZEPHYR__VERBOSE_
    if (loop_counter_1 == NUM_OF_LOOPS) // cs time
    {
#ifdef _ZEPHYR__VERBOSE_
      print_console("L1: ");
      print_console_int(loop_counter_1);
      print_console_newline();
#endif // _ZEPHYR__VERBOSE_
      print_console("  CSTime(ticks): ");
      print_console_int((int)measurements_hires__measurement_avg());
      print_console_newline();

      measurements_hires__finish();
      tests_reports__test_ok();
    }
    loop_counter_1++;
    other_task_executed = false;
#ifdef _ZEPHYR__VERBOSE_    
    print_console("Start measurements task1 ....");
#endif // _ZEPHYR__VERBOSE_
    measurements_hires__start_measurement();

    k_sleep(next_time1_k);

    // clock_nanosleep(CLOCK_MONOTONIC, TIMER_ABSTIME, &next_time1, NULL);
  }
}

//*******//
// TASK2 //
//*******//
struct timespec next_time_other = TS(0, 0);
k_timeout_t period_other_k = K_MSEC(0);

void *
other_task()
{
  while (1)
  {
    if (!other_task_executed)
    {
      measurements_hires__end_measurement();
#ifdef _ZEPHYR__VERBOSE_      
      print_console("... End measurements other task\n");
#endif // _ZEPHYR__VERBOSE_
    }

#ifdef _ZEPHYR__VERBOSE_
    print_console("Other Task\n");
#endif // _ZEPHYR__VERBOSE_

    other_task_executed = true;
    k_sleep(period_other_k); // sleeps 0;
  }
}

int main(int argc, char const *argv[])
{
  int rc;

  pthread_t thread1, thread_other;
  pthread_attr_t attr1, attr_other;
  struct sched_param sch_param = {.sched_priority = 3};

  m2osinit();
  check_posix_api();
  console_init(115200);

  measurements_hires__init();

  print_console("\nCS_Delay_Simple\n");
  print_console("\nMain starts\n");
  // TEST CODE

  pthread_attr_init(&attr1);
  pthread_attr_init(&attr_other);

  // Stack size
  pthread_attr_setstacksize(&attr1, STACK_SIZE);
  pthread_attr_setstacksize(&attr_other, STACK_SIZE);

  // Scheduling policy
  rc = pthread_attr_setschedpolicy(&attr1, SCHED_FIFO);
  if (rc != 0)
    handle_error_en(rc, "pthread_attr_setschedpolicy");
  rc = pthread_attr_setschedpolicy(&attr_other, SCHED_FIFO);
  if (rc != 0)
    handle_error_en(rc, "pthread_attr_setschedpolicy");

  // Priorities
  rc = pthread_attr_setschedparam(&attr1, &sch_param);
  if (rc != 0)
    handle_error_en(rc, "pthread_attr_setschedparam");
  rc = pthread_attr_setschedparam(&attr_other, &sch_param);
  if (rc != 0)
    handle_error_en(rc, "pthread_attr_setschedparam");

  // Thread stack
  rc = pthread_attr_setstack(&attr1, thread_stack[0], STACK_SIZE);
  if (rc != 0)
    handle_error_en(rc, "pthread_attr_setstack");
  rc = pthread_attr_setstack(&attr_other, thread_stack[1], STACK_SIZE);
  if (rc != 0)
    handle_error_en(rc, "pthread_attr_setstack");

  // Create threads
  rc = pthread_create(&thread1, &attr1, task1, NULL);
  if (rc != 0)
    handle_error_en(rc, "pthread_create");
  rc = pthread_create(&thread_other, &attr_other, other_task, NULL);
  if (rc != 0)
    handle_error_en(rc, "pthread_create");

  // join threads
  pthread_join(thread1, NULL);
  pthread_join(thread_other, NULL);
  print_console("\nMain ends\n");
  return 0;
}
```
