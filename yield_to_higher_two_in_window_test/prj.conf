## CMakeLists.txt
```
# SPDX-License-Identifier: Apache-2.0

cmake_minimum_required(VERSION 3.20.0)

find_package(Zephyr REQUIRED HINTS $ENV{ZEPHYR_BASE})
project(yield_yield_to_higher_two_in_window_test)

target_sources(app PRIVATE src/main.c)
#set_compiler_property(PROPERTY optimization_speed)
#target_compile_options(app PRIVATE -O2 -g0)

target_include_directories(app PRIVATE ${ZEPHYR_BASE}/lib/posix/options)
target_include_directories(app PRIVATE ${ZEPHYR_BASE}/kernel/include)    
```

## prj.conf
```kconfig
CONFIG_POSIX_API=y

CONFIG_POSIX_SEMAPHORES=y
CONFIG_POSIX_PRIORITY_SCHEDULING=y # for sched_get_priority_min(), sched_get_priority_max()
CONFIG_PTHREAD_IPC=y 
# Habilitar soporte para nanosleep
CONFIG_POSIX_TIMERS=y
# API POSIX para threads
CONFIG_POSIX_THREADS=y
CONFIG_SCHED_DUMB=y 
CONFIG_WAITQ_DUMB=y
#CONFIG_TIMESLICE_SIZE= # 100 comentado para que se cambie en función del test 
CONFIG_POSIX_THREAD_ATTR_STACKSIZE=y
CONFIG_POSIX_THREAD_CPUTIME=y

#CONFIG_THREAD_ANALYZER_AUTO=y

CONFIG_THREAD_ANALYZER=y
CONFIG_THREAD_ANALYZER_USE_PRINTK=y 
CONFIG_THREAD_ANALYZER_AUTO=y
CONFIG_THREAD_RUNTIME_STATS=y
CONFIG_THREAD_NAME=y
CONFIG_THREAD_MONITOR=y

# CONFIG_SCHED_THREAD_USAGE=y
# CONFIG_SCHED_THREAD_USAGE_ANALYSIS=y

CONFIG_PRINTK=y

#OPCIONES DE OPTIMIZACION
# CONFIG_DEBUG=y
#CONFIG_DEBUG=n
#CONFIG_DEBUG_OPTIMIZATIONS=n
#CONFIG_NO_OPTIMIZATIONS=n
#CONFIG_SIZE_OPTIMIZATIONS=y
#CONFIG_COMPILER_OPT="-02"
CONFIG_SPEED_OPTIMIZATIONS=y

#Stack usage
CONFIG_THREAD_STACK_INFO=y
CONFIG_INIT_STACKS=y
CONFIG_STACK_USAGE=y
```

## src/main.c
```c
// Test of yield_to_higher() using the M2OS POSIX-like layer.
// Two threads are executed in a yield_to_higher() "window" of th_lp:
//
// th_hp #..........._____#........#....                ^ = thread activation
//       ^           ^             ^                    # = thread execution
// th_mp _#..........______#......._#...                _ = thread active
//       ^           ^             ^                    . = thread suspended
// th_lp __###############__#..........#                y = yield_to_higher
//       ^               y             ^
//       0         1         2         3
//
#include "../headers/headers.h"
#include <zephyr/debug/thread_analyzer.h>

THREAD_POOL(3);

#define NUM_THREADS 3
#define STACK_SIZE 512

K_THREAD_STACK_ARRAY_DEFINE(thread_stack, NUM_THREADS, STACK_SIZE);

#define COUNT_LP_END_VALUE 2
int count_lp = 0;
int count_mp = 0;
int count_hp = 0;

int global_stack_base;

#define DELTA_NS 100000000
#define PERIOD_LP_NS (3 * DELTA_NS)
#define PERIOD_MP_NS (1.2 * DELTA_NS)
#define PERIOD_HP_NS (1.2 * DELTA_NS)
#define DELAY_ACTIVATION_LP_NS (PERIOD_HP_NS / 10)
const struct timespec period_lp = TS(0, PERIOD_LP_NS);
const struct timespec period_mp = TS(0, PERIOD_MP_NS);
const struct timespec period_hp = TS(0, PERIOD_HP_NS);
const struct timespec eat_lp = TS(0, 1.5 * DELTA_NS);

#define BUFFER_SIZE 10

void puts_now(char *msg)
{
  struct timespec now;
  clock_gettime(CLOCK_MONOTONIC, &now);
  printf("%lld", now.tv_sec); printf("s");
  printf("%ld", now.tv_nsec / 100000); printf("ms ");
  printf(msg);
}

// void check_stack_usage(k_tid_t thread, struct k_thread *thread_data)
// {
//   size_t total_stack = k_thread_stack_size_get(thread_data);
//   // size_t unused_stack = k_thread_stack_space_get(thread_data);
//   size_t *unused_ptr;
//   size_t unused_stack = k_thread_stack_space_get(thread, &unused_ptr);
//   size_t used_stack = total_stack - unused_stack;

//   printf("Stack total: %zu bytes\n", total_stack);
//   printf("Stack usado: %zu bytes\n", used_stack);
//   printf("Stack libre: %zu bytes\n", unused_stack);
// }

void print_stack_info(void)
{
  struct k_thread *current_thread = k_current_get();
  void *stack_base = current_thread->stack_info.start;
  size_t stack_size = current_thread->stack_info.size;

  printf("Thread: %p\n", current_thread);
  printf("Stack base: %p\n", stack_base);
  printf("Stack size: %zu bytes\n", stack_size);
}

void print_stack_size(void)
{
  struct k_thread *current_thread = k_current_get();
  size_t stack_size = current_thread->stack_info.size;
  printf("Stack size: %zu bytes\n", stack_size);
}

static inline void print_thread_stack_base(void)
{
  printk("Stack base: %p\n", thread_stack);
}

static inline uint32_t get_stack_pointer(void)
{
  uint32_t sp;
  __asm volatile("mov %0, sp" : "=r"(sp));
  return sp;
}

static inline void print_stack_pointer(void)
{
  uint32_t sp = get_stack_pointer();
  printk("Stack Pointer actual: %p\n", (void *)sp);
}

//********//
// TASK-L //
//********//

struct timespec next_activation_time_lp = TS(0, 0);

void *
task_l()
{

  while (1)
  {
    // printf("\n");
    // puts_now("Task LP\n");
    // print_thread_stack_base();
    // print_stack_pointer();
    // print_stack_info();

    count_lp++;
    const int value = 100 * count_hp + 10 * count_mp + count_lp;
    int a[BUFFER_SIZE];
    for (int i = 0; i < BUFFER_SIZE; i++)
    {
      a[i] = value;
    }
    for (int i = 0; i < BUFFER_SIZE; i++)
    {
      // printf("%d ", a[i]);
      tests_reports__assert(a[i] == value);
    }
    // printf("\n");
    // tests_reports__assert((count_lp == 1 && count_hp == 1 && count_mp == 1) || (count_lp == 2 && count_hp == 3 && count_mp == 3));
    if (count_lp == COUNT_LP_END_VALUE)
    {
      unsigned int cpu = 0;
      thread_analyzer_print(cpu);
      tests_reports__test_ok();
    }

    // puts_now("Thread LP: eat\n");
    tests_reports__eat(eat_lp);

    // TODO: mas cosas
    // puts_now("Thread LP: before k_yield()\n");
    // TODO get stack pointer and stack size
    // const int stack_before = get_stack_pointer();
    // print_stack_size();
    
    
    
    // k_yield();
    
    
    
    
    // tests_reports__assert(stack_before == get_stack_pointer());
    // const int stack_after = get_stack_pointer();
    // printf("Stack before: %d | Stack after: %d\n", stack_before, stack_after);
    // print_stack_size();
    // puts_now("Thread LP: after k_yield()\n");
    
    // tests_reports__assert(count_hp == 2 && count_mp == 2 && count_lp == 1);

    for (int i = 0; i < BUFFER_SIZE; i++)
    {
      // printf("%d ",  a[i]);
      tests_reports__assert(a[i] == value);
    }
    // printf("\n");

    // puts_now("Thread LP: clock_nanosleep()\n");
    TS_INC(next_activation_time_lp, period_lp);
    clock_nanosleep(CLOCK_MONOTONIC, TIMER_ABSTIME,
                    &next_activation_time_lp, NULL);
  }

  return NULL;
}

//********//
// TASK-M //
//********//

struct timespec next_activation_time_ms = TS(0, 0);
int first_activation_m = 1;

void *
task_m()
{

  while (1)
  {
    // printf("\n");
    // puts_now("Task MP\n");
    // print_thread_stack_base();
    // print_stack_pointer();
    // print_stack_info();

    count_mp++;

    if (first_activation_m)
    {
      first_activation_m = 0;

      // tests_reports__assert(count_hp == 1 && count_mp == 1 && count_lp == 0);
      // puts_now("Task MP: first clock_nanosleep()\n");
      TS_INC(next_activation_time_ms, period_mp);
      clock_nanosleep(CLOCK_MONOTONIC, TIMER_ABSTIME, &next_activation_time_ms, NULL);
    }
    else
    {
      // tests_reports__assert(count_mp == count_hp && count_lp == 1);
      // puts_now("Task MP: clock_nanosleep()\n");
      TS_INC(next_activation_time_ms, period_mp);
      clock_nanosleep(CLOCK_MONOTONIC, TIMER_ABSTIME, &next_activation_time_ms, NULL);
    }
  }
  return NULL;
}

//********//
// TASK-H //
//********//

struct timespec next_activation_time_hp = TS(0, 0);
int first_activation_hp = 1;

void *
task_h()
{

  while (1)
  {
    // printf("\n");
    // puts_now("Task HP\n");
    // print_thread_stack_base();
    // print_stack_pointer();
    // print_stack_info();
    // print stack pointer

    count_hp++;

    if (first_activation_hp)
    {
      first_activation_hp = 0;
      // tests_reports__assert(count_hp == 1 && count_lp == 0 && count_mp == 0);
      // puts_now("Task HP: first clock_nanosleep()\n");
      TS_INC(next_activation_time_hp, period_hp);
      clock_nanosleep(CLOCK_MONOTONIC, TIMER_ABSTIME, &next_activation_time_hp, NULL);
    }
    else
    {
      // tests_reports__assert(count_mp == count_hp - 1 && count_lp == 1);
      // puts_now("Task HP: clock_nanosleep()\n");
      TS_INC(next_activation_time_hp, period_hp);
      clock_nanosleep(CLOCK_MONOTONIC, TIMER_ABSTIME, &next_activation_time_hp, NULL);
    }
  }
  return NULL;
}

int main(int argc, char const *argv[])
{
  int rc;

  pthread_t thread_h, thread_l, thread_m;
  pthread_attr_t attr_h, attr_l, attr_m;
  struct sched_param sch_param_h = {.sched_priority = 15};
  struct sched_param sch_param_m = {.sched_priority = 10};
  struct sched_param sch_param_l = {.sched_priority = 5};

  m2osinit();
  check_posix_api();
  console_init(115200);

  // init measurements

  print_console("\n Yield to higher two in window test\n");
  // print_console("\nMain starts\n");
  // CODE HERE
  // print_stack_pointer();
  // print_stack_info();

  pthread_attr_init(&attr_h);
  pthread_attr_init(&attr_m);
  pthread_attr_init(&attr_l);

  // Stack size
  pthread_attr_setstacksize(&attr_h, STACK_SIZE);
  pthread_attr_setstacksize(&attr_m, STACK_SIZE);
  pthread_attr_setstacksize(&attr_l, STACK_SIZE);

  // Politica de planificación FIXME -> PROBAR ROUND ROBIN
  rc = pthread_attr_setschedpolicy(&attr_h, SCHED_FIFO);
  if (rc != 0)
    handle_error_en(rc, "pthread_attr_setschedpolicy");
  rc = pthread_attr_setschedpolicy(&attr_m, SCHED_FIFO);
  if (rc != 0)
    handle_error_en(rc, "pthread_attr_setschedpolicy");
  rc = pthread_attr_setschedpolicy(&attr_l, SCHED_FIFO);
  if (rc != 0)
    handle_error_en(rc, "pthread_attr_setschedpolicy");

  // Prioridades
  rc = pthread_attr_setschedparam(&attr_h, &sch_param_h);
  if (rc != 0)
    handle_error_en(rc, "pthread_attr_setschedparam h");
  rc = pthread_attr_setschedparam(&attr_m, &sch_param_m);
  if (rc != 0)
    handle_error_en(rc, "pthread_attr_setschedparam m");
  rc = pthread_attr_setschedparam(&attr_l, &sch_param_l);
  if (rc != 0)
    handle_error_en(rc, "pthread_attr_setschedparam l");

  // Thread stack
  rc = pthread_attr_setstack(&attr_h, thread_stack[0], STACK_SIZE);
  if (rc != 0)
    handle_error_en(rc, "pthread_attr_setstack");
  rc = pthread_attr_setstack(&attr_m, thread_stack[1], STACK_SIZE);
  if (rc != 0)
    handle_error_en(rc, "pthread_attr_setstack");
  rc = pthread_attr_setstack(&attr_l, thread_stack[2], STACK_SIZE);
  if (rc != 0)
    handle_error_en(rc, "pthread_attr_setstack");

  // Create threads
  rc = pthread_create(&thread_h, &attr_h, task_h, NULL);
  if (rc != 0)
    handle_error_en(rc, "pthread_create");
  rc = pthread_create(&thread_m, &attr_m, task_m, NULL);
  if (rc != 0)
    handle_error_en(rc, "pthread_create");
  rc = pthread_create(&thread_l, &attr_l, task_l, NULL);
  if (rc != 0)
    handle_error_en(rc, "pthread_create");

  // join thread
  pthread_join(thread_h, NULL);
  pthread_join(thread_m, NULL);
  pthread_join(thread_l, NULL);
  // print_console("\nMain ends\n");
  return 0;
}
```
