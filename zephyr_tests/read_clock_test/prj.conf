## CMakeLists.txt
```
# SPDX-License-Identifier: Apache-2.0

cmake_minimum_required(VERSION 3.20.0)

find_package(Zephyr REQUIRED HINTS $ENV{ZEPHYR_BASE})
project(read_clock_test)

target_sources(app PRIVATE src/main.c)

target_include_directories(app PRIVATE ${ZEPHYR_BASE}/lib/posix/options)
target_include_directories(app PRIVATE ${ZEPHYR_BASE}/kernel/include)    
```

## prj.conf
```kconfig
CONFIG_POSIX_API=y

#CONFIG_POSIX_PRIORITY_SCHEDULING=y # for sched_get_priority_min(), sched_get_priority_max()
CONFIG_PTHREAD_IPC=y 

# Habilitar soporte para nanosleep
CONFIG_POSIX_TIMERS=y
# API POSIX para threads
CONFIG_POSIX_THREADS=y
CONFIG_SCHED_DUMB=y 
CONFIG_WAITQ_DUMB=y
CONFIG_TIMESLICE_SIZE=100 
CONFIG_POSIX_THREAD_ATTR_STACKSIZE=y
CONFIG_POSIX_THREAD_CPUTIME=y

CONFIG_TIMING_FUNCTIONS=y

#CONFIG_THREAD_ANALYZER_AUTO=y
CONFIG_THREAD_ANALYZER=y
CONFIG_THREAD_RUNTIME_STATS=y
#CONFIG_THREAD_NAME=y

CONFIG_SCHED_THREAD_USAGE=y
CONFIG_SCHED_THREAD_USAGE_ANALYSIS=y

CONFIG_PRINTK=y

#OPCIONES DE OPTIMIZACION
CONFIG_DEBUG=n
CONFIG_DEBUG_OPTIMIZATIONS=n
CONFIG_NO_OPTIMIZATIONS=n
CONFIG_SIZE_OPTIMIZATIONS=y
CONFIG_COMPILER_OPT="-02"
```

## src/main.c
```c
#include "../headers/headers.h"

//THREAD_POOL (1);

#define NUM_OF_LOOPS 10
#define MEAS_PER_LOOP 100
#define EAT_LOOPS 1000
const struct timespec eat_ts_var = TS (0, 100000);

#define NUM_OF_MEAS 20
uint32_t hwt[NUM_OF_MEAS];
uint32_t hwtv[NUM_OF_MEAS];

int
main (int argc, char **argv)
{
  m2osinit ();
  console_init (115200);
  set_systick_reload (0xFFFFFF);
  print_console ("\nMain starts\n");
  measurements_hires__init ();

  for (int i = 0; i < NUM_OF_LOOPS; i++)
    {
      measurements_hires__reset ();
      for (int j = 0; j < MEAS_PER_LOOP; j++)
        {
          measurements_hires__start_measurement ();
          for (int k = 0; k < EAT_LOOPS * i; k++)
            {
            }
          measurements_hires__end_measurement ();
        }
      // putint(EAT_LOOPS * i);
      print_console_int (EAT_LOOPS * i);
      // puts(":");
      print_console (":");
      // measurements_hires__print_measures_data();
      measurements_hires__print_measures_data_serial ();
    }
  //  puts("Main ends\n");
  print_console ("\nMain ends");
  tests_reports__test_ok (); //FIXME
  return 0;
}
```
