## zephyr_tests/timespesc_to_hw_test/sample.yaml
```yaml
sample:
  description: Example POSIX app
    application
  name: posix_app
common:
  tags: posix_app
  integration_platforms:
    - native_sim
  harness: console
  harness_config:
    type: one_line
    regex:
      - "Hello World! (.*)"
tests:
  sample.basic.helloworld:
    tags: introduction
```
